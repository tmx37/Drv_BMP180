## west.yml
```yaml
manifest:
  remotes:
    - name: tmx37_github
      url-base: git@github.com:tmx37

  projects:

    - name: GenUtl
      remote: tmx37_github
      repo-path: GenUtl_EmbeddedC
      revision: develop
      path: Drv_BMP180/module_libs

self: 
  path: Drv_BMP180/Drivers
```
